/* Generated by `riscv-tools generate-memory-map` from src/cyclone-v/fpga-uart-jtag/platform.yaml.
 * Do not edit by hand: change the platform YAML and run it again.
 *
 * Linker script for boot_memory.S, the fixed bootloader. It is
 * built and written once; rv32_wait_restart is pinned to a fixed
 * address that the images of the tests reach as an absolute symbol.
 */

MEMORY
{
  boot_memory (rx) : ORIGIN = 0x0, LENGTH = 0x1000
}

RESET_RESERVED = 0x100;

OUTPUT_ARCH("riscv")
ENTRY(_reset)

SECTIONS
{
  .text.reset 0x0 : { *(.text.reset) } > boot_memory
  ASSERT(SIZEOF(.text.reset) <= RESET_RESERVED,
         "boot_memory.S: _reset grew past RESET_RESERVED")

  .text.wait_restart RESET_RESERVED :
    { *(.text.wait_restart) } > boot_memory

  . = ALIGN(4);
  ASSERT(. <= ORIGIN(boot_memory) + LENGTH(boot_memory),
         "boot_memory.S exceeds the BOOT_MEMORY")
}
