/* Generated by `riscv-tools generate-memory-map` from src/cyclone-v/fpga-external-data/platform.yaml.
 * Do not edit by hand: change the platform YAML and run it again.
 *
 * Linker script for boot_rom.S, the fixed bootloader. It is built
 * and written once; rv32_wait_restart is pinned to a fixed address
 * that the images of the tests reach as an absolute symbol.
 */

MEMORY
{
  boot_rom (rx) : ORIGIN = 0x0, LENGTH = 0x1000
}

RESET_RESERVED = 0x100;

OUTPUT_ARCH("riscv")
ENTRY(_reset)

SECTIONS
{
  .text.reset 0x0 : { *(.text.reset) } > boot_rom
  ASSERT(SIZEOF(.text.reset) <= RESET_RESERVED,
         "boot_rom.S: _reset grew past RESET_RESERVED")

  .text.wait_restart RESET_RESERVED :
    { *(.text.wait_restart) } > boot_rom

  . = ALIGN(4);
  ASSERT(. <= ORIGIN(boot_rom) + LENGTH(boot_rom),
         "boot_rom.S exceeds the BOOT_ROM")
}
